## myKeyboardV1/zmk/boards/shields/terence0_left/Kconfig.shield
```kconfig
# Copyright (c) 2025 Terence Ng
# SPDX-License-Identifier: MIT

config SHIELD_TERENCE0_LEFT
    def_bool $(shields_list_contains,terence0_left)

config SHIELD_TERENCE0_RIGHT
    def_bool $(shields_list_contains,terence0_right)

config SHIELD_TERENCE0_DONGLE
    def_bool $(shields_list_contains,terence0_dongle)
```
